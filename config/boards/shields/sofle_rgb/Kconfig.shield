## config/boards/shields/sofle_rgb/Kconfig.shield
```kconfig
config SHIELD_SOFLE_RGB_LEFT
       def_bool $(shields_list_contains,sofle_rgb_left)

config SHIELD_SOFLE_RGB_RIGHT
       def_bool $(shields_list_contains,sofle_rgb_right)

CONFIG_ZMK_IDLE_TIMEOUT=550000
```
